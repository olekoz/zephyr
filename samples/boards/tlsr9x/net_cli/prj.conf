## prj.conf
```kconfig
# Copyright (c) 2025 Telink Semiconductor
# SPDX-License-Identifier: Apache-2.0

# enable networks
CONFIG_NETWORKING=y
CONFIG_WIFI=y
CONFIG_NET_L2_OPENTHREAD=y
CONFIG_NET_IF_MAX_IPV6_COUNT=4
CONFIG_NET_DHCPV6=y
CONFIG_NET_CONFIG_AUTO_INIT=n
CONFIG_NET_DEFAULT_IF_ETHERNET=y

# networks features
# CONFIG_NET_PKT_TXTIME=y
# CONFIG_NET_PKT_TIMESTAMP=y

# thread v1.3 features
CONFIG_OPENTHREAD_THREAD_VERSION_1_3=y
CONFIG_OPENTHREAD_SRP_CLIENT=y
CONFIG_OPENTHREAD_SRP_SERVER=y
CONFIG_OPENTHREAD_JOINER=y
CONFIG_OPENTHREAD_LINK_METRICS_SUBJECT=y
CONFIG_OPENTHREAD_BORDER_ROUTER=y
CONFIG_OPENTHREAD_BORDER_ROUTING=y
CONFIG_OPENTHREAD_BORDER_ROUTING_COUNTERS=y
CONFIG_OPENTHREAD_COMMISSIONER=y
CONFIG_OPENTHREAD_PING_SENDER=y
CONFIG_OPENTHREAD_DHCP6_CLIENT=y
CONFIG_OPENTHREAD_DNS_CLIENT=y
CONFIG_OPENTHREAD_SLAAC=y
CONFIG_OPENTHREAD_REFERENCE_DEVICE=y
CONFIG_OPENTHREAD_MLR=y
CONFIG_OPENTHREAD_MAC_FILTER=y
CONFIG_OPENTHREAD_DUA=y
CONFIG_OPENTHREAD_COAP=y
CONFIG_OPENTHREAD_COAPS=y
CONFIG_MBEDTLS_PEM_CERTIFICATE_FORMAT=y
CONFIG_OPENTHREAD_ENABLE_SERVICE=y
CONFIG_OPENTHREAD_NUM_MESSAGE_BUFFERS=350
CONFIG_OPENTHREAD_CSL_RECEIVE_TIME_AHEAD=480

# Logging & shell
CONFIG_LOG=y
CONFIG_LOG_MODE_MINIMAL=y
CONFIG_SHELL_VT100_COMMANDS=n
CONFIG_NET_SHELL=y
CONFIG_NET_L2_WIFI_SHELL=y
CONFIG_OPENTHREAD_SHELL=y

# thread network credentials
CONFIG_OPENTHREAD_CHANNEL=18
# 0x1418 = 5144
CONFIG_OPENTHREAD_PANID=5144
CONFIG_OPENTHREAD_XPANID="00:0d:b8:00:00:00:00:00"
CONFIG_OPENTHREAD_NETWORKKEY="ff:11:22:33:44:55:66:77:88:99:aa:bb:cc:dd:ee:ff"

# general
CONFIG_COMMON_LIBC_MALLOC_ARENA_SIZE=12288

# enable mDNS
CONFIG_NET_HOSTNAME_ENABLE=y
CONFIG_NET_HOSTNAME="telink-net-cli"
CONFIG_MDNS_RESPONDER=y
CONFIG_DNS_SD=y
CONFIG_MDNS_RESPONDER_DNS_SD=y
CONFIG_NET_SOCKETS_POLL_MAX=8

# Wifi-credentials
CONFIG_BR_WIFI_SSID="TLNK-2.4G"
CONFIG_BR_WIFI_PASSWORD="temporary1"
```

## src/main.c
```c
/*
 * Copyright (c) 2025 Telink
 *
 * SPDX-License-Identifier: Apache-2.0
 */

#include "connections.h"

#include <zephyr/net/openthread.h>
#include <openthread/border_routing.h>
#include <openthread/platform/infra_if.h>

#include <zephyr/net/icmp.h>

#include <zephyr/logging/log.h>
LOG_MODULE_REGISTER(main, LOG_LEVEL_INF);

static struct net_icmp_ctx icmp_rs_ctx, icmp_ra_ctx, icmp_na_ctx;

static int icmp_input(struct net_icmp_ctx *ctx, struct net_pkt *pkt,
	struct net_icmp_ip_hdr *hdr, struct net_icmp_hdr *icmp_hdr, void *user_data)
{
	if (hdr->family != AF_INET6) {
		return 0;
	}
	if (hdr->ipv6->hop_limit != 255) {
		return 0;
	}
	if (!net_ipv6_is_ll_addr((struct in6_addr *)hdr->ipv6->src)) {
		return 0;
	}

	size_t tot_len = net_pkt_get_len(pkt);
	uint8_t ip_len = net_pkt_ip_hdr_len(pkt);

	if (tot_len > ip_len) {
		uint8_t icmp_data[tot_len - ip_len];
		struct net_pkt_cursor bkp;

		net_pkt_cursor_backup(pkt, &bkp);
		net_pkt_cursor_init(pkt);
		do {
			if (net_pkt_skip(pkt, ip_len) < 0) {
				break;
			}
			if (net_pkt_read(pkt, icmp_data, sizeof(icmp_data)) < 0) {
				break;
			}
			otPlatInfraIfRecvIcmp6Nd(openthread_get_default_instance(),
				net_if_get_by_iface(ctx->iface), (otIp6Address *)hdr->ipv6->src,
				icmp_data, sizeof(icmp_data));
		} while (0);
		net_pkt_cursor_restore(pkt, &bkp);
	}
	return 0;
}

void wifi_changed(struct net_if *iface, bool is_connected)
{
	if (is_connected) {
		LOG_INF("** wifi connected");
		otError err = otBorderRoutingInit(openthread_get_default_instance(),
			net_if_get_by_iface(iface), true);

		if (err == OT_ERROR_NONE) {
			(void) net_icmp_init_ctx(&icmp_rs_ctx, 133, 0, icmp_input);
			icmp_rs_ctx.iface = iface;
			(void) net_icmp_init_ctx(&icmp_ra_ctx, 134, 0, icmp_input);
			icmp_ra_ctx.iface = iface;
			(void) net_icmp_init_ctx(&icmp_na_ctx, 136, 0, icmp_input);
			icmp_na_ctx.iface = iface;
			err = otBorderRoutingSetEnabled(openthread_get_default_instance(), true);
			if (err == OT_ERROR_NONE) {
				LOG_INF("openthread border router enabled");
			} else {
				LOG_ERR("openthread border router enabling failed %d", err);
			}
		} else {
			LOG_ERR("openthread border router init failed %d", err);
		}
	} else {
		LOG_WRN("** wifi disconnected");
		otError err = otBorderRoutingSetEnabled(openthread_get_default_instance(), false);
		(void) net_icmp_cleanup_ctx(&icmp_rs_ctx);
		(void) net_icmp_cleanup_ctx(&icmp_ra_ctx);
		(void) net_icmp_cleanup_ctx(&icmp_na_ctx);

		if (err == OT_ERROR_NONE) {
			LOG_INF("openthread border router disabled");
		} else {
			LOG_ERR("openthread border router disabling failed %d", err);
		}
	}
}

void thread_changed(otInstance *instance, otDeviceRole role)
{
	ARG_UNUSED(instance);

	LOG_INF("** Openthread %s", otThreadDeviceRoleToString(role));
}

int main(void)
{
	LOG_INF("***** Network CLI on Zephyr (%s) *****", net_if_get_default()->config.name);

	connections_init(wifi_changed, thread_changed);

	return 0;
}
```

## src/connections.c
```c
/*
 * Copyright (c) 2025 Telink
 *
 * SPDX-License-Identifier: Apache-2.0
 */

#include "connections.h"

#include <zephyr/init.h>
#include <zephyr/net/net_config.h>
#include <zephyr/net/wifi_mgmt.h>
#include <zephyr/net/openthread.h>

#include <zephyr/logging/log.h>
LOG_MODULE_REGISTER(connections, LOG_LEVEL_INF);

#if CONFIG_OPENTHREAD_MANUAL_START
#error openthread is not auto started
#endif /* CONFIG_OPENTHREAD_MANUAL_START */
#if !CONFIG_NET_DEFAULT_IF_ETHERNET
#error ethernet is not default interface
#endif /* CONFIG_OPENTHREAD_MANUAL_START */

static connections_wifi_changed connections_wifi_changed_cb = NULL;
static connections_thread_changed connections_thread_changed_cb = NULL;

static void wifi_connect(void)
{
	LOG_INF("wifi connecting to '%s'...", CONFIG_BR_WIFI_SSID);

	for(bool con_requested = false; !con_requested;) {
		struct wifi_connect_req_params connect_req_params = {
			.ssid = CONFIG_BR_WIFI_SSID,
			.ssid_length = strlen(CONFIG_BR_WIFI_SSID),
			.psk = CONFIG_BR_WIFI_PASSWORD,
			.psk_length = strlen(CONFIG_BR_WIFI_PASSWORD),
			.security = WIFI_SECURITY_TYPE_PSK};

		if (net_mgmt(NET_REQUEST_WIFI_CONNECT, net_if_get_default(),
			&connect_req_params, sizeof(connect_req_params))) {
			con_requested = true;
		} else {
			k_msleep(100);
		}
	}
}

static void wifi_connection_changed(struct net_mgmt_event_callback *cb, uint32_t mgmt_event,
	struct net_if *iface)
{
	switch (mgmt_event) {
	case NET_EVENT_WIFI_CONNECT_RESULT: {
		const struct wifi_status *status = (const struct wifi_status *)cb->info;

		if (!status->status) {
			if (connections_wifi_changed_cb) {
				connections_wifi_changed_cb(iface, true);
			}
		} else {
			LOG_ERR("wifi connection error %d", status->status);
		}
		} break;
	case NET_EVENT_WIFI_DISCONNECT_RESULT:
		if (connections_wifi_changed_cb) {
			connections_wifi_changed_cb(iface, false);
		}
		LOG_INF("wifi reconnect");
		wifi_connect();
		break;
	}
}

static void ot_connection_changed(otChangedFlags flags,
	struct openthread_context *ot_context, void *user_data)
{
	ARG_UNUSED(user_data);

	if (flags & OT_CHANGED_THREAD_ROLE) {
		if (connections_thread_changed_cb) {
			connections_thread_changed_cb(ot_context->instance,
				otThreadGetDeviceRole(ot_context->instance));
		}
	}
}

void connections_init(connections_wifi_changed on_wifi, connections_thread_changed on_thread)
{
	static const struct in6_addr icmp_rs_addr = {
		.s6_addr = {
			0xff, 0x02, 0x00, 0x00, 0x00, 0x00, 0x00, 0x00,
			0x00, 0x00, 0x00, 0x00, 0x00, 0x00, 0x00, 0x02
		}
	};

	net_if_ipv6_maddr_join(net_if_get_default(),
		net_if_ipv6_maddr_add(net_if_get_default(), &icmp_rs_addr));

	connections_wifi_changed_cb = on_wifi;
	connections_thread_changed_cb = on_thread;

	static struct net_mgmt_event_callback wifi_callback;

	net_mgmt_init_event_callback(&wifi_callback, wifi_connection_changed,
		NET_EVENT_WIFI_CONNECT_RESULT | NET_EVENT_WIFI_DISCONNECT_RESULT);
	net_mgmt_add_event_callback(&wifi_callback);

	static struct openthread_state_changed_cb ot_callback = {
		.state_changed_cb = ot_connection_changed
	};

	openthread_state_changed_cb_register(openthread_get_default_context(), &ot_callback);

	if (net_if_is_wifi(net_if_get_default())) {
		wifi_connect();
	} else {
		LOG_ERR("wifi is not default interface");
	}
}

#if !CONFIG_NET_CONFIG_AUTO_INIT

static int init_application(void)
{
	const char *app_info = "Initializing network";

	STRUCT_SECTION_FOREACH(net_if, iface) {
		if (net_if_is_up(iface)) {
			(void)net_config_init_app(net_if_get_device(iface), app_info);
		} else {
			LOG_INF("interface: %s is down\n", iface->config.name);
		}
	}
	return 0;
}

SYS_INIT(init_application, APPLICATION, CONFIG_NET_CONFIG_INIT_PRIO);

#endif /* !CONFIG_NET_CONFIG_AUTO_INIT */
```
