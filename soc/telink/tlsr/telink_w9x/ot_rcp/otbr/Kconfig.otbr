## soc/telink/tlsr/telink_w9x/ot_rcp/otbr/Kconfig.otbr
```kconfig
# Copyright (c) 2025 Telink Semiconductor
# SPDX-License-Identifier: Apache-2.0

config OPENTHREAD_BORDER_ROUTING
	select POSIX_API
```
